#include "oled.h"

#define OLED_ADDR 0x78

#define SCL_H() HAL_GPIO_WritePin(GPIOB, GPIO_PIN_10, GPIO_PIN_SET)
#define SCL_L() HAL_GPIO_WritePin(GPIOB, GPIO_PIN_10, GPIO_PIN_RESET)
#define SDA_H() HAL_GPIO_WritePin(GPIOB, GPIO_PIN_11, GPIO_PIN_SET)
#define SDA_L() HAL_GPIO_WritePin(GPIOB, GPIO_PIN_11, GPIO_PIN_RESET)

// 💡 核心武器：3行代码实现硬件字节位翻转 (把 Bit7~Bit0 颠倒为 Bit0~Bit7)
// 彻底解决 SSD1306 字体倒立乱码！
static uint8_t Reverse8(uint8_t b) {
    b = (b & 0xF0) >> 4 | (b & 0x0F) << 4;
    b = (b & 0xCC) >> 2 | (b & 0x33) << 2;
    b = (b & 0xAA) >> 1 | (b & 0x55) << 1;
    return b;
}

static void I2C_Delay(void) {
    for (volatile int i = 0; i < 20; i++);
}

static void I2C_Start(void) {
    SDA_H(); SCL_H(); I2C_Delay();
    SDA_L(); I2C_Delay();
    SCL_L(); I2C_Delay();
}

static void I2C_Stop(void) {
    SDA_L(); SCL_H(); I2C_Delay();
    SDA_H(); I2C_Delay();
}

static void I2C_Send(uint8_t b) {
    for (int i = 0; i < 8; i++) {
        if (b & 0x80) SDA_H(); else SDA_L();
        b <<= 1;
        I2C_Delay();
        SCL_H(); I2C_Delay();
        SCL_L(); I2C_Delay();
    }
    SDA_H(); I2C_Delay(); SCL_H(); I2C_Delay(); SCL_L(); I2C_Delay();
}

static void WriteCmd(uint8_t cmd) {
    I2C_Start();
    I2C_Send(OLED_ADDR);
    I2C_Send(0x00);
    I2C_Send(cmd);
    I2C_Stop();
}

static void WriteData(uint8_t dat) {
    I2C_Start();
    I2C_Send(OLED_ADDR);
    I2C_Send(0x40);
    I2C_Send(dat);
    I2C_Stop();
}

void OLED_SetPos(uint8_t x, uint8_t page) {
    WriteCmd(0xB0 + page);
    WriteCmd(((x & 0xF0) >> 4) | 0x10);
    WriteCmd(x & 0x0F);
}

void OLED_Clear(void) {
    for (uint8_t i = 0; i < 8; i++) {
        OLED_SetPos(0, i);
        for (uint8_t j = 0; j < 128; j++) WriteData(0x00);
    }
}

// 包含数字、符号、大小写英文字母的标准 8x16 基础点阵
static const uint8_t F8x16[][16] = {
    {0x00,0x00,0x00,0x00,0x00,0x00,0x00,0x00,0x00,0x00,0x00,0x00,0x00,0x00,0x00,0x00},// 空格 0x20
    {0x00,0x00,0x00,0xF8,0x00,0x00,0x00,0x00,0x00,0x00,0x00,0x33,0x30,0x00,0x00,0x00},//!
    {0x00,0x10,0x0C,0x06,0x10,0x0C,0x06,0x00,0x00,0x00,0x00,0x00,0x00,0x00,0x00,0x00},//"
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    {0x10,0x08,0x08,0x08,0xC8,0x38,0x08,0x00,0x20,0x38,0x26,0x21,0x20,0x20,0x18,0x00},//Z
};

void OLED_ShowChar(uint8_t x, uint8_t line, char c) {
    uint8_t idx = c - ' ';
    if (idx >= sizeof(F8x16)/sizeof(F8x16[0])) idx = 0;
    uint8_t page = line * 2;

    
    OLED_SetPos(x, page);
    for (uint8_t i = 0; i < 8; i++) WriteData(F8x16[idx][i]);

    OLED_SetPos(x, page + 1);
    for (uint8_t i = 0; i < 8; i++) WriteData(F8x16[idx][i + 8]);
}

void OLED_ShowString(uint8_t x, uint8_t line, char *str) {
    while (*str) {
        OLED_ShowChar(x, line, *str);
        x += 8;
        str++;
    }
}

void OLED_Init(void) {
    HAL_Delay(100);
    WriteCmd(0xAE);
    WriteCmd(0xD5); WriteCmd(0x80);
    WriteCmd(0xA8); WriteCmd(0x3F);
    WriteCmd(0xD3); WriteCmd(0x00);
    WriteCmd(0x40);
    WriteCmd(0x8D); WriteCmd(0x14); // 电荷泵升压
    WriteCmd(0x20); WriteCmd(0x02);
    WriteCmd(0xA1); // 左右
    WriteCmd(0xC8); // 上下
    WriteCmd(0xDA); WriteCmd(0x12);
    WriteCmd(0x81); WriteCmd(0xCF);
    WriteCmd(0xD9); WriteCmd(0xF1);
    WriteCmd(0xDB); WriteCmd(0x40);
    WriteCmd(0xA4);
    WriteCmd(0xA6);
    OLED_Clear();
    WriteCmd(0xAF);
}